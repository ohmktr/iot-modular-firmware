## build/Kconfig/arch/Kconfig
```kconfig
# Load Zephyr Arch Kconfig descriptions.
osource "C:/deviot/zephyrproject/zephyr/arch/x86/Kconfig"
osource "C:/deviot/zephyrproject/zephyr/arch/xtensa/Kconfig"
osource "C:/deviot/zephyrproject/zephyr/arch/sparc/Kconfig"
osource "C:/deviot/zephyrproject/zephyr/arch/riscv/Kconfig"
osource "C:/deviot/zephyrproject/zephyr/arch/posix/Kconfig"
osource "C:/deviot/zephyrproject/zephyr/arch/nios2/Kconfig"
osource "C:/deviot/zephyrproject/zephyr/arch/mips/Kconfig"
osource "C:/deviot/zephyrproject/zephyr/arch/arm64/Kconfig"
osource "C:/deviot/zephyrproject/zephyr/arch/arm/Kconfig"
osource "C:/deviot/zephyrproject/zephyr/arch/arc/Kconfig"
```

## build/Kconfig/boards/Kconfig.defconfig
```kconfig
# Load Zephyr board defconfig descriptions.
osource "C:/deviot/zephyrproject/zephyr/boards/st/nucleo_h563zi/Kconfig.defconfig"
```

## build/Kconfig/boards/Kconfig.nucleo_h563zi
```kconfig
# Load board Kconfig descriptions.
osource "C:/deviot/zephyrproject/zephyr/boards/st/nucleo_h563zi/Kconfig.nucleo_h563zi"
```

## build/Kconfig/boards/Kconfig.sysbuild
```kconfig
# Load Sysbuild board Kconfig descriptions.
osource "C:/deviot/zephyrproject/zephyr/boards/st/nucleo_h563zi/Kconfig.sysbuild"
```
