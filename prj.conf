## CMakeLists.txt
```
# SPDX-License-Identifier: Apache-2.0
cmake_minimum_required(VERSION 3.20.0)
find_package(Zephyr REQUIRED HINTS $ENV{ZEPHYR_BASE})
project(dev_space)

# เพิ่ม source files ที่ต้องการเข้าไปใน target
target_sources(app PRIVATE 
    src/main/main.c         # Main application source
    src/components/buzzer.c # Buzzer source file
    src/components/led.c    # LED source file
    src/components/led1.c
    src/components/uart_com.c
    src/application/protocol_check.c
)

# เพิ่ม include directory ของ components
zephyr_include_directories(src/components)
zephyr_include_directories(src/application)

# SPDX-License-Identifier: Apache-2.0
```

## prj.conf
```kconfig
CONFIG_SERIAL=y
CONFIG_UART_INTERRUPT_DRIVEN=y
CONFIG_USE_SEGGER_RTT=y          # เปิดใช้งาน RTT
CONFIG_RTT_CONSOLE=y             # ใช้ RTT เป็น Console Output
CONFIG_UART_CONSOLE=n            # ปิด UART Console (ใช้ RTT แทน)
CONFIG_PRINTK=y                  # เปิดใช้งาน printk

CONFIG_CBPRINTF_FP_SUPPORT=y
```

## src/main.c
```c
/*
 * Copyright (c) 2016 Intel Corporation
 *
 * SPDX-License-Identifier: Apache-2.0
 */

#include <stdio.h>
#include <zephyr/kernel.h>
#include <zephyr/drivers/gpio.h>


/* 1000 msec = 1 sec */
#define SLEEP_TIME_MS   1000

/* The devicetree node identifier for the "led0" alias. */
#define LED0_NODE DT_ALIAS(led0)
static const struct gpio_dt_spec led = GPIO_DT_SPEC_GET(LED0_NODE, gpios);

int main(void)
{
	int ret;
	bool led_state = true;

	if (!gpio_is_ready_dt(&led)) {
		return 0;
	}

	ret = gpio_pin_configure_dt(&led, GPIO_OUTPUT_ACTIVE);
	if (ret < 0) {
		return 0;
	}

	while (1) {
		ret = gpio_pin_toggle_dt(&led);
		if (ret < 0) {
			return 0;
		}

		led_state = !led_state;
		printf("LED state: %s\n", led_state ? "ON" : "OFF");
		k_msleep(SLEEP_TIME_MS);
	}
	return 0;
}
```
